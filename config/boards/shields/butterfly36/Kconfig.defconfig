## config/boards/shields/butterfly36/Kconfig.defconfig
```kconfig
if SHIELD_BUTTERFLY36_LEFT

config ZMK_KEYBOARD_NAME
	default "Butterfly36"

config ZMK_SPLIT_ROLE_CENTRAL
	default y

endif

if SHIELD_BUTTERFLY36_LEFT || SHIELD_BUTTERFLY36_RIGHT

config ZMK_SPLIT
	default y

endif
```

## config/boards/shields/butterfly36/Kconfig.shield
```kconfig
config SHIELD_BUTTERFLY36_LEFT
    def_bool $(shields_list_contains,butterfly36_left)

config SHIELD_BUTTERFLY36_RIGHT
    def_bool $(shields_list_contains,butterfly36_right)
```

## config/boards/shields/microbox34/Kconfig.defconfig
```kconfig
if SHIELD_MICROBOX34_LEFT

config ZMK_KEYBOARD_NAME
	default "Microbox34"

config ZMK_SPLIT_ROLE_CENTRAL
	default y

endif

if SHIELD_MICROBOX34_LEFT || SHIELD_MICROBOX34_RIGHT

config ZMK_SPLIT
	default y

endif
```

## config/boards/shields/microbox34/Kconfig.shield
```kconfig
config SHIELD_MICROBOX34_LEFT
    def_bool $(shields_list_contains,microbox34_left)

config SHIELD_MICROBOX34_RIGHT
    def_bool $(shields_list_contains,microbox34_right)
```

## config/boards/shields/sweep34/Kconfig.defconfig
```kconfig
if SHIELD_SWEEP34_LEFT

config ZMK_KEYBOARD_NAME
	default "Sweep34"

config ZMK_SPLIT_ROLE_CENTRAL
	default y

endif

if SHIELD_SWEEP34_LEFT || SHIELD_SWEEP34_RIGHT

config ZMK_SPLIT
	default y

endif
```

## config/boards/shields/sweep34/Kconfig.shield
```kconfig
config SHIELD_SWEEP34_LEFT
    def_bool $(shields_list_contains,sweep34_left)

config SHIELD_SWEEP34_RIGHT
    def_bool $(shields_list_contains,sweep34_right)
```
